## config/boards/shields/bananapad/Kconfig.defconfig
```kconfig
# Copyright (c) 2021 The ZMK Contributors
# SPDX-License-Identifier: MIT

if SHIELD_BANANAPAD

config ZMK_KEYBOARD_NAME
	default "BananaPad"

endif
```

## config/boards/shields/bananapad/Kconfig.shield
```kconfig
# Copyright (c) 2021 The ZMK Contributors
# SPDX-License-Identifier: MIT

config SHIELD_BANANAPAD
	def_bool $(shields_list_contains,bananapad)
```

## config/boards/shields/dactyl_cc/Kconfig.defconfig
```kconfig
# Copyright (c) 2021 The ZMK Contributors
# SPDX-License-Identifier: MIT

if SHIELD_DACTYL_CC_LEFT

config ZMK_KEYBOARD_NAME
	default "Dactyl-cc"

config ZMK_SPLIT_BLE_ROLE_CENTRAL
	default y

endif

if SHIELD_DACTYL_CC_LEFT || SHIELD_DACTYL_CC_RIGHT

config ZMK_SPLIT
	default y

endif
```

## config/boards/shields/dactyl_cc/Kconfig.shield
```kconfig
# Copyright (c) 2021 The ZMK Contributors
# SPDX-License-Identifier: MIT

config SHIELD_DACTYL_CC_LEFT
	def_bool $(shields_list_contains,dactyl_cc_left)

config SHIELD_DACTYL_CC_RIGHT
	def_bool $(shields_list_contains,dactyl_cc_right)
```

## config/boards/shields/forty_percent/Kconfig.shield
```kconfig
# Copyright (c) 2021 The ZMK Contributors
# SPDX-License-Identifier: MIT

config SHIELD_FORTY_PERCENT
	def_bool $(shields_list_contains,forty_percent)
```

## config/boards/shields/joypad/Kconfig.defconfig
```kconfig
# Copyright (c) 2021 The ZMK Contributors
# SPDX-License-Identifier: MIT

if SHIELD_JOYPAD

config ZMK_KEYBOARD_NAME
	default "Joypad"

endif
```

## config/west.yml
```yaml
manifest:
  remotes:
    - name: zmkfirmware
      url-base: https://github.com/zmkfirmware
    - name: dactylcc
      url-base: https://github.com/cgoates
  projects:
    - name: zmk
      remote: zmkfirmware
      revision: main
      import: app/west.yml
  self:
    path: config
```
